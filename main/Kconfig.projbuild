## main/Kconfig.projbuild
```kconfig
menu "Dual-FOC GP"

    config DFGP_HAPTIC_DEFAULT_STEPS
        int "Number of haptic detent steps per revolution"
        range 2 360
        default 21
        help
            Number of equal detent positions per full motor revolution.
            The haptic engine snaps the rotor to the nearest detent.

    config DFGP_HAPTIC_MAX_CURRENT
        int "Maximum current sent to the Roller485 (register 0x20)"
        range 0 120000
        default 20000
        help
            Maximum motor current limit, written to the Roller485
            position-mode max-current register (0x20).  The unit is the
            same as expected by the Roller485 firmware (0.01 mA, so a
            value of 20000 corresponds to 200 mA).  Higher values give
            stronger detent snap-to torque but draw more current.

    comment "I2C bus 1 (Roller485 unit #1)"

    config DFGP_ROLLER1_SDA_GPIO
        int "Roller485 #1 SDA GPIO"
        range 0 48
        default 9
        help
            GPIO number used for the SDA line of the I2C bus that talks
            to Roller485 unit #1.

    config DFGP_ROLLER1_SCL_GPIO
        int "Roller485 #1 SCL GPIO"
        range 0 48
        default 10
        help
            GPIO number used for the SCL line of the I2C bus that talks
            to Roller485 unit #1.

    comment "I2C bus 2 (Roller485 unit #2)"

    config DFGP_ROLLER2_SDA_GPIO
        int "Roller485 #2 SDA GPIO"
        range 0 48
        default 11
        help
            GPIO number used for the SDA line of the I2C bus that talks
            to Roller485 unit #2.

    config DFGP_ROLLER2_SCL_GPIO
        int "Roller485 #2 SCL GPIO"
        range 0 48
        default 12
        help
            GPIO number used for the SCL line of the I2C bus that talks
            to Roller485 unit #2.

    config DFGP_ROLLER_I2C_FREQ_HZ
        int "Roller485 I2C clock frequency (Hz)"
        range 100000 1000000
        default 400000
        help
            I2C clock speed for both Roller485 buses, in Hz.

    comment "Game controller buttons (active-low, internal pull-up)"

    config DFGP_BUTTON0_GPIO
        int "Button 0 GPIO"
        range 0 48
        default 4

    config DFGP_BUTTON1_GPIO
        int "Button 1 GPIO"
        range 0 48
        default 5

    config DFGP_BUTTON2_GPIO
        int "Button 2 GPIO"
        range 0 48
        default 6

    config DFGP_BUTTON3_GPIO
        int "Button 3 GPIO"
        range 0 48
        default 7

    config DFGP_BUTTON4_GPIO
        int "Button 4 GPIO"
        range 0 48
        default 8

    config DFGP_BUTTON5_GPIO
        int "Button 5 GPIO"
        range 0 48
        default 18

    config DFGP_BUTTON6_GPIO
        int "Button 6 GPIO"
        range 0 48
        default 21

    config DFGP_BUTTON7_GPIO
        int "Button 7 GPIO"
        range 0 48
        default 36

    config DFGP_BUTTON8_GPIO
        int "Button 8 GPIO"
        range 0 48
        default 37

    config DFGP_BUTTON9_GPIO
        int "Button 9 GPIO"
        range 0 48
        default 38

    config DFGP_MODE_TOGGLE_GPIO
        int "Mode toggle GPIO (haptic <-> continuous, active-low)"
        range 0 48
        default 35
        help
            GPIO that toggles between haptic-detent and continuous
            centering modes.  Active-low with internal pull-up.

    comment "Status LED"

    choice DFGP_STATUS_LED_TYPE
        prompt "Status LED type"
        default DFGP_STATUS_LED_WS2812
        help
            Selects the kind of status RGB LED used to indicate the
            current operating mode (red while booting, green for
            haptic mode, blue for continuous mode).

        config DFGP_STATUS_LED_WS2812
            bool "Single WS2812 (NeoPixel) on one GPIO"
            help
                A single addressable WS2812 / NeoPixel LED driven from
                one GPIO via the RMT peripheral.  Default for the
                ESP32-S3 DevKitC and similar boards.

        config DFGP_STATUS_LED_RGB_GPIOS
            bool "Three discrete LEDs on three GPIOs"
            help
                Three separate single-colour LEDs (red, green, blue)
                each driven from its own GPIO.  Matches the on-board
                RGB LED of the Waveshare ESP32-S3-Nano.

        config DFGP_STATUS_LED_NONE
            bool "No status LED"
            help
                Disable status-LED reporting entirely.  No pins are
                used and no LED driver is initialised.

    endchoice

    config DFGP_STATUS_LED_WS2812_GPIO
        int "WS2812 status-LED GPIO"
        depends on DFGP_STATUS_LED_WS2812
        range 0 48
        default 48
        help
            GPIO connected to the data input of the WS2812 LED.

    config DFGP_STATUS_LED_R_GPIO
        int "Red LED GPIO"
        depends on DFGP_STATUS_LED_RGB_GPIOS
        range 0 48
        default 46

    config DFGP_STATUS_LED_G_GPIO
        int "Green LED GPIO"
        depends on DFGP_STATUS_LED_RGB_GPIOS
        range 0 48
        default 0

    config DFGP_STATUS_LED_B_GPIO
        int "Blue LED GPIO"
        depends on DFGP_STATUS_LED_RGB_GPIOS
        range 0 48
        default 45

    config DFGP_STATUS_LED_RGB_ACTIVE_LOW
        bool "Discrete RGB LEDs are active-low"
        depends on DFGP_STATUS_LED_RGB_GPIOS
        default n
        help
            Enable if the discrete RGB LED is wired so that driving
            the GPIO low turns the LED on (common-anode arrangement).

endmenu
```

## sdkconfig.defaults
```kconfig
# Target
CONFIG_IDF_TARGET="esp32s3"

# USB – HID gamepad with 1 interface
CONFIG_TINYUSB_HID_COUNT=1

# FreeRTOS
CONFIG_FREERTOS_HZ=1000
```
